// Code generated by bin/img2cpp, bin/gltf2cpp, bin/dbones2cpp and
// bin/svg2cpp: the headers under test/data are checked in; regenerate them
// with the scripts in test/tools.

#include <cmath>
#include <cstdint>
#include <cstdlib>
#include <cstring>

#include "check.hpp"
#include "data/test_image_argb4444.hpp"
#include "data/test_image_gray1.hpp"
#include "data/test_image_rgb444.hpp"
#include "data/test_image_rgb565.hpp"
#include "data/test_image_rgb565_swapped.hpp"
#include "data/test_model.hpp"
#include "data/test_model_packed.hpp"
#include "data/test_rig.hpp"
#include "data/test_rig_keyed.hpp"
#include "data/test_vg.hpp"
#include "data/test_vg_anim.hpp"
#include "data/test_vg_text.hpp"
#include "shapoco/gfx2d/fonts.hpp"
#include "shapoco/gfx2d/rig.hpp"
#include "shapoco/gfx2d/surface_alloc.hpp"
#include "shapoco/gfx3d/gfx3d.hpp"

namespace g2 = shapoco::gfx2d;
namespace g3 = shapoco::gfx3d;

// Same formula as test/tools/make_test_image.py
static g2::Color testImagePixel(int x, int y) {
  return g2::makeColor((x * 19) % 256, (y * 36) % 256, (x * y * 7) % 256,
                       (x + y) % 5 == 0 ? 0 : 255);
}

static int absDiff(int a, int b) { return a > b ? a - b : b - a; }

// The generated texture must hold the source pixels within the quantization
// step of its format (the tool rounds, the library truncates: allow 1 step).
static void checkTexture(const g2::Texture &t, int stepR, int stepG, int stepB,
                         bool alpha, bool gray) {
  CHECK_EQ(t.width, 13);
  CHECK_EQ(t.height, 7);
  CHECK_EQ(t.stride, g2::minStride(t.format, 13));
  g2::Graphics2D g;  // only used for pixel reading via a temporary Surface
  g2::Surface s = {t.format, t.width, t.height, t.stride,
                   const_cast<void *>(t.pixels)};
  g.setTarget(s);
  for (int y = 0; y < 7; y++) {
    for (int x = 0; x < 13; x++) {
      g2::Color want = testImagePixel(x, y);
      g2::Color got = g.getPixel(x, y);
      if (gray) {
        CHECK_EQ(got, g2::gray1ToColor(g2::colorToGray1(want)));
        continue;
      }
      CHECK(absDiff(g2::colorR(got), g2::colorR(want)) <= stepR);
      CHECK(absDiff(g2::colorG(got), g2::colorG(want)) <= stepG);
      CHECK(absDiff(g2::colorB(got), g2::colorB(want)) <= stepB);
      if (alpha) CHECK(absDiff(g2::colorA(got), g2::colorA(want)) <= 17);
    }
  }
}

static void testImg2cpp() {
  CHECK_EQ((int)test_image_rgb565_swapped::texture.format,
           (int)g2::PixelFormat::RGB565_SWAPPED);
  CHECK_EQ((int)test_image_argb4444::texture.format,
           (int)g2::PixelFormat::ARGB4444);
  CHECK_EQ((int)test_image_rgb444::texture.format,
           (int)g2::PixelFormat::RGB444);
  CHECK_EQ((int)test_image_gray1::texture.format, (int)g2::PixelFormat::GRAY1);
  checkTexture(test_image_rgb565_swapped::texture, 9, 5, 9, false, false);
#if SHAPOGFX_FORMAT_RGB565
  CHECK_EQ((int)test_image_rgb565::texture.format,
           (int)g2::PixelFormat::RGB565);
  checkTexture(test_image_rgb565::texture, 9, 5, 9, false, false);
#endif
  checkTexture(test_image_argb4444::texture, 17, 17, 17, true, false);
  checkTexture(test_image_rgb444::texture, 17, 17, 17, false, false);
  checkTexture(test_image_gray1::texture, 0, 0, 0, false, true);
}

static uint8_t arena[128 * 1024];

// Skips the node called `skip` and spins the node called `spin`
class TestVisitor : public g3::NodeVisitor {
 public:
  const char *skip = nullptr;
  const char *spin = nullptr;
  int visited = 0;
  bool onNode(const g3::Node &node, g3::mat4f &local) override {
    visited++;
    if (skip && node.name && std::strcmp(node.name, skip) == 0) return false;
    if (spin && node.name && std::strcmp(node.name, spin) == 0) {
      local = local * g3::mat4f::rotation(1.0f, {0, 1, 0});
    }
    return true;
  }
};

static int renderSceneOf(g3::Graphics3D &r, const g2::Surface &s,
                         const g3::Scene &scene, g3::NodeVisitor *v) {
  r.setPerspectiveProjection(1.0f, (float)s.width / s.height, 0.3f, 50.0f);
  r.beginScene();
  r.lookAt({2.5f, 2.0f, 3.0f}, {0, 0.3f, 0});
  r.enableParallelLight({-0.5f, -1, -0.4f}, {1, 1, 1, 1});
  r.enableEnvironmentLight({0.3f, 0.3f, 0.3f, 1});
  r.putScene(scene, v);
  r.endScene();
  r.beginRender();
  r.render(0, 0, s.width, s.height, s);
  r.endRender();
  return r.getStats().triCount;
}

static int renderScene(g3::Graphics3D &r, const g2::Surface &s,
                       g3::NodeVisitor *v) {
  return renderSceneOf(r, s, test_model::scene, v);
}

// The packed (16-byte) vertex form of the same model must draw the same
// picture: positions are quantized to 1/65534 of the model's extent and
// normals to 1/127, both far below the resolution of the output format.
static void testPackedVertices() {
  CHECK_EQ(sizeof(g3::PackedVertex), 16u);
  const g3::VertexBuffer &vb =
      *test_model_packed::node_Cube.mesh->primitives[0].vertexBuffer;
  CHECK(vb.vertices == nullptr);
  CHECK(vb.packed != nullptr);
  CHECK_EQ(vb.vertexCount,
           test_model::node_Cube.mesh->primitives[0].vertexBuffer->vertexCount);

  static constexpr int W = 96, H = 64;
  g3::Graphics3D r;
  r.init(W, H, arena, sizeof(arena));
  g2::OwnedSurface a = g2::createSurface(g2::PixelFormat::RGB565_SWAPPED, W, H);
  g2::OwnedSurface b = g2::createSurface(g2::PixelFormat::RGB565_SWAPPED, W, H);
  const int triA = renderSceneOf(r, a, test_model::scene, nullptr);
  const int triB = renderSceneOf(r, b, test_model_packed::scene, nullptr);
  CHECK_EQ(triA, triB);
  CHECK(triA > 0);

  // Compare per channel; a quantized vertex may move a silhouette pixel
  int differing = 0;
  const uint16_t *pa = (const uint16_t *)a.pixels();
  const uint16_t *pb = (const uint16_t *)b.pixels();
  for (int i = 0; i < W * H; i++) {
    g2::Color ca = g2::rgb565ToColor(g2::bswap16(pa[i]));
    g2::Color cb = g2::rgb565ToColor(g2::bswap16(pb[i]));
    if (absDiff(g2::colorR(ca), g2::colorR(cb)) > 24 ||
        absDiff(g2::colorG(ca), g2::colorG(cb)) > 24 ||
        absDiff(g2::colorB(ca), g2::colorB(cb)) > 24) {
      differing++;
    }
  }
  CHECK(differing <= W * H / 100);
}

static void testGltf2cpp() {
  // Structure produced from test/data/test_model.glb
  CHECK_EQ(test_model::scene.rootCount, 1);
  CHECK(test_model::scene.roots[0] == &test_model::node_Root);
  CHECK_EQ(test_model::node_Root.childCount, 3);
  CHECK(test_model::node_Root.children[0] == &test_model::node_Cube);
  CHECK(test_model::node_Root.children[1] == &test_model::node_Pyramid);
  CHECK(test_model::node_Root.children[2] == &test_model::node_Axes);
  // LINES primitive: unlit vertex colors, no material in the glTF -> default
  // material
  const g3::Primitive &axes = test_model::node_Axes.mesh->primitives[0];
  CHECK_EQ((int)axes.type, (int)g3::PrimitiveType::LINES);
  CHECK_EQ(axes.indexCount, 6);
  CHECK((axes.material->flags & g3::MaterialFlags::VERTEX_COLOR) != 0);
  CHECK_EQ(axes.vertexBuffer->vertices[1].color, 0xFFFF0000u);
  CHECK_EQ(test_model::node_Pyramid.childCount, 1);
  CHECK(std::strcmp(test_model::node_Tip_Pyramid.name, "Tip Pyramid") == 0);
  CHECK(test_model::node_Cube.mesh != nullptr);
  CHECK_EQ(test_model::node_Cube.mesh->primitiveCount, 1);
  const g3::Primitive &cube = test_model::node_Cube.mesh->primitives[0];
  CHECK_EQ(cube.vertexBuffer->vertexCount, 24);
  CHECK_EQ(cube.indexCount, 36);
  CHECK(cube.material->texture != nullptr);
  CHECK((cube.material->flags & g3::MaterialFlags::TEXTURE) != 0);
  CHECK((cube.material->flags & g3::MaterialFlags::VERTEX_COLOR) != 0);
  CHECK_EQ(cube.material->texture->width, 16);
  // Pyramid: normals were generated, material is double-sided and red
  const g3::Primitive &pyr = test_model::node_Pyramid.mesh->primitives[0];
  CHECK((pyr.material->flags & g3::MaterialFlags::DOUBLE_SIDED) != 0);
  CHECK(pyr.material->diffuse.r > 0.8f && pyr.material->diffuse.g < 0.3f);
  float len = g3::length(pyr.vertexBuffer->vertices[4].normal);
  CHECK(len > 0.99f && len < 1.01f);
  CHECK(pyr.vertexBuffer->vertices[4].normal.y >
        0.9f);  // apex normal points up
  // Node transform: rotation of 45 degrees around Y and translation
  const g3::mat4f &m = test_model::node_Cube.transform;
  CHECK(std::abs(m.m[0] - 0.7071f) < 0.001f &&
        std::abs(m.m[12] + 0.8f) < 0.001f);
  // Members reserved for later features: the node table in glTF order, the
  // TRS each transform was composed from, zeros elsewhere
  CHECK_EQ(test_model::scene.nodeCount, 5);
  CHECK(test_model::scene.nodes[0] == &test_model::node_Root);
  CHECK(test_model::scene.nodes[1] == &test_model::node_Cube);
  CHECK(test_model::scene.nodes[3] == &test_model::node_Tip_Pyramid);
  CHECK_EQ(cube.flags, 0);
  CHECK_EQ(cube.material->alphaCutoff, 0);
  CHECK_EQ(cube.material->wrap, 0);
  CHECK_EQ(cube.material->shininess, 0);
  CHECK_EQ(test_model::node_Cube.mesh->flags, 0);
  CHECK_EQ(test_model::node_Cube.flags, 0);
  for (int i = 0; i < test_model::scene.nodeCount; i++) {
    const g3::Node &n = *test_model::scene.nodes[i];
    CHECK(n.trs != nullptr);
    if (!n.trs) continue;
    const g3::NodeTRS &t = *n.trs;
    g3::mat4f sc = g3::mat4f::identity();
    sc.m[0] = t.scale.x;
    sc.m[5] = t.scale.y;
    sc.m[10] = t.scale.z;
    const g3::mat4f c =
        g3::mat4f::translation(t.translation.x, t.translation.y,
                               t.translation.z) *
        g3::mat4f::fromQuaternion(t.rotation[0], t.rotation[1], t.rotation[2],
                                  t.rotation[3]) *
        sc;
    bool same = true;
    for (int k = 0; k < 16; k++)
      same = same && std::abs(c.m[k] - n.transform.m[k]) < 1e-4f;
    CHECK(same);
  }
  CHECK(std::abs(test_model::node_Pyramid.trs->scale.x - 1.5f) < 1e-6f);
#pragma GCC diagnostic push
#pragma GCC diagnostic ignored "-Wmissing-field-initializers"
  // Hand-written data from before the reserved members: compiles, and the
  // members are zero
  static const g3::Mesh oldMesh = {nullptr, 0};
  static const g3::Node oldNode = {"n", g3::mat4f::identity(), &oldMesh,
                                   nullptr, 0};
  static const g3::Node *const oldRoots[] = {&oldNode};
  static const g3::Scene oldScene = {oldRoots, 1};
#pragma GCC diagnostic pop
  CHECK_EQ(oldMesh.flags, 0);
  CHECK_EQ(oldNode.flags, 0);
  CHECK(oldNode.trs == nullptr);
  CHECK_EQ(oldScene.nodeCount, 0);
  CHECK(oldScene.nodes == nullptr);

  // Traversal: everything draws, indices are valid, nothing is dropped
  g3::Graphics3D r;
  r.init(96, 64, arena, sizeof(arena));
  r.setClearColor({0, 0, 0, 1});
  g2::OwnedSurface a =
      g2::createSurface(g2::PixelFormat::RGB565_SWAPPED, 96, 64);
  g2::OwnedSurface b =
      g2::createSurface(g2::PixelFormat::RGB565_SWAPPED, 96, 64);
  int all = renderScene(r, a, nullptr);
  CHECK(all > 0);
  CHECK_EQ(r.getStats().badIndices, 0);
  CHECK_EQ(r.getStats().nodesDropped, 0);
  // Visitor: skipping the pyramid subtree removes its triangles and its child's
  TestVisitor v;
  v.skip = "Pyramid";
  int noPyramid = renderScene(r, b, &v);
  CHECK(noPyramid < all);
  CHECK_EQ(v.visited,
           4);  // Root, Cube, Pyramid, Axes (Pyramid's child not visited)
  // Visitor: modifying a transform changes the image but not the triangle count
  TestVisitor spin;
  spin.spin = "Cube";
  int spun = renderScene(r, b, &spin);
  CHECK(spun > 0);
  CHECK(std::memcmp(a.pixels(), b.pixels(), a.bytes()) != 0);
}

// A chain deeper than the state stack is cut off and counted, without crashing
static void testDeepTree() {
  static g3::Node chain[24];
  static const g3::Node *childPtr[24];
  for (int i = 0; i < 24; i++) {
    childPtr[i] = (i + 1 < 24) ? &chain[i + 1] : nullptr;
    chain[i] = {nullptr, g3::mat4f::translation(0.1f, 0, 0),
                test_model::node_Cube.mesh,
                (i + 1 < 24) ? &childPtr[i] : nullptr,
                (uint16_t)((i + 1 < 24) ? 1 : 0), 0, nullptr};
  }
  g3::Graphics3D r;
  r.init(32, 32, arena, sizeof(arena));
  g2::OwnedSurface s =
      g2::createSurface(g2::PixelFormat::RGB565_SWAPPED, 32, 32);
  r.setOrthographicProjection(-4, 4, -4, 4, 0.1f, 10);
  r.beginScene();
  r.translate(0, 0, -5);
  r.putNode(chain[0]);
  r.endScene();
  r.beginRender();
  r.render(0, 0, 32, 32, s);
  r.endRender();
  g3::Stats st = r.getStats();
  CHECK(st.nodesDropped > 0);
  CHECK(st.triCount > 0);
  CHECK_EQ(st.badIndices, 0);
}

// Same formula as test/tools/make_test_rig.py (image 4 is a diagonal bar,
// image 5 translucent inside an opaque border)
static g2::Color rigImagePixel(int index, int x, int y, int w, int h) {
  const bool cornerX = x == 0 || x == w - 1, cornerY = y == 0 || y == h - 1;
  int a = (cornerX && cornerY) ? 0 : ((cornerX || cornerY) ? 136 : 255);
  if (index == 4) a = (x >= 1 && x <= 13 && std::abs(x - y) <= 1) ? 255 : 0;
  if (index == 5) a = (cornerX || cornerY) ? 255 : 128;
  return g2::makeColor((40 + 60 * index + 13 * x) % 256,
                       (200 + 70 * index + 17 * y) % 256,
                       (90 * index + 7 * x * y) % 256, a);
}

// The hull of an attachment holds every opaque pixel of its image (their
// corners), has at most 8 vertices, and leaves out some of the transparent
// ones: `opaque` says which pixels of the image count
template <typename F>
static void checkHull(const shapoco::gfx2d::rig::Attachment &at, F opaque) {
  const int n = at.hullCount;
  CHECK(at.hull != nullptr && n >= 3 && n <= 8);
  if (!at.hull || n < 3) return;
  const int16_t *h = at.hull;
  long area2 = 0;
  for (int i = 0; i < n; i++) {
    const int j = (i + 1) % n;
    area2 += (long)h[2 * i] * h[2 * j + 1] - (long)h[2 * j] * h[2 * i + 1];
  }
  const long sign = area2 >= 0 ? 1 : -1;
  auto inside = [&](int x, int y) {
    for (int i = 0; i < n; i++) {
      const int j = (i + 1) % n;
      const long f = (long)(h[2 * j] - h[2 * i]) * (y - h[2 * i + 1]) -
                     (long)(h[2 * j + 1] - h[2 * i + 1]) * (x - h[2 * i]);
      if (sign * f < 0) return false;
    }
    return true;
  };
  int transparentOut = 0;
  for (int y = 0; y < at.src.height; y++) {
    for (int x = 0; x < at.src.width; x++) {
      const bool in = inside(x, y) && inside(x + 1, y) && inside(x, y + 1) &&
                      inside(x + 1, y + 1);
      if (opaque(x, y)) {
        CHECK(in);
      } else if (!in) {
        transparentOut++;
      }
    }
  }
  CHECK(transparentOut > 0);
}

// The atlas of dbones2cpp holds the images of the test armature where the
// attachments say, quantized to the output format; the key color output
// paints the transparent pixels (alpha below 128) in the key
static void checkRigAtlas(const shapoco::gfx2d::rig::Armature &arm,
                          bool keyed) {
  // Image of each attachment: slot sb (b, d), sroot (d), sa (a), sc (c)
  static const struct {
    const char *slot;
    int attachment, image, w, h;
  } expect[] = {{"sb", 0, 1, 5, 9},
                {"sb", 1, 3, 4, 4},
                {"sroot", 0, 3, 4, 4},
                {"sa", 0, 0, 8, 6},
                {"sc", 0, 2, 7, 7},
                // e's transparent columns 0, 14 and 15 are trimmed off
                {"se", 0, 4, 13, 14},
                {"sf", 0, 5, 8, 8}};
  g2::Graphics2D g;
  for (const auto &e : expect) {
    const shapoco::gfx2d::rig::Slot *slot = nullptr;
    for (int s = 0; s < arm.slotCount; s++) {
      if (std::strcmp(arm.slots[s].name, e.slot) == 0) slot = &arm.slots[s];
    }
    CHECK(slot != nullptr);
    if (!slot) continue;
    const shapoco::gfx2d::rig::Attachment &at = slot->attachments[e.attachment];
    CHECK_EQ(at.src.width, e.w);
    CHECK_EQ(at.src.height, e.h);
    // The images' opaque pixels after the trim (e lost its first column); f
    // is a full rectangle, which gets no hull
    const int ox = e.image == 4 ? 1 : 0;
    if (e.image == 5) {
      CHECK_EQ(at.hullCount, 0);
    } else {
      checkHull(at, [&](int x, int y) {
        return g2::colorA(rigImagePixel(e.image, x + ox, y, e.w + ox, e.h)) >=
               (keyed ? 128 : 9);
      });
    }
    const g2::Texture &t = *at.texture;
    g2::Surface s = {t.format, t.width, t.height, t.stride,
                     const_cast<void *>(t.pixels)};
    g.setTarget(s);
    if (!g.hasTarget()) continue;  // format disabled
    for (int y = 0; y < e.h; y++) {
      for (int x = 0; x < e.w; x++) {
        const g2::Color want = rigImagePixel(e.image, x + ox, y, e.w + ox, e.h);
        const g2::Color got = g.getPixel(at.src.x + x, at.src.y + y, false);
        if (keyed && g2::colorA(want) < 128) {
          CHECK_EQ(got & 0xFFFFFFu, arm.colorKey & 0xFFFFFFu);
          continue;
        }
        const int step = keyed ? 9 : 17;
        CHECK(absDiff(g2::colorR(got), g2::colorR(want)) <= step);
        CHECK(absDiff(g2::colorG(got), g2::colorG(want)) <= (keyed ? 5 : 17));
        CHECK(absDiff(g2::colorB(got), g2::colorB(want)) <= step);
        if (!keyed) CHECK(absDiff(g2::colorA(got), g2::colorA(want)) <= 17);
      }
    }
  }
}

static void testDbones2cpp() {
  CHECK_EQ((int)test_rig::atlas.format, (int)g2::PixelFormat::ARGB4444);
  CHECK_EQ(test_rig::atlas.width, 64);  // --atlas-width 64
  CHECK_EQ(test_rig::atlas.stride, 128u);
  checkRigAtlas(test_rig::armature, false);
  checkRigAtlas(test_rig_keyed::armature, true);
}

// A color as the target format keeps it
static g2::Color quantized(g2::PixelFormat fmt, g2::Color c) {
  g2::OwnedSurface s = g2::createSurface(fmt, 1, 1);
  g2::Graphics2D g(s);
  g.clear(c);
  return g.getPixel(0, 0, false);
}

#if SHAPOGFX2D_RIG && SHAPOGFX2D_TRANSFORM
static bool nearColor(g2::Color a, g2::Color b, int tol) {
  return absDiff(g2::colorR(a), g2::colorR(b)) <= tol &&
         absDiff(g2::colorG(a), g2::colorG(b)) <= tol &&
         absDiff(g2::colorB(a), g2::colorB(b)) <= tol;
}
#endif

static int lumOf(g2::Color c) {
  return (g2::colorR(c) + g2::colorG(c) + g2::colorB(c)) / 3;
}

// The picture svg2cpp made of test/data/test_vg.svg (see make_test_vg.py)
static void testSvg2cppPicture() {
  namespace vg = g2::vg;
  const g2::PixelFormat FMT = g2::PixelFormat::RGB565_SWAPPED;
  const vg::Picture &pic = test_vg::picture;
  CHECK_EQ(pic.shapeCount, 19);
  CHECK_EQ(pic.features, 0);
  CHECK(pic.bounds.width == 160.0f && pic.bounds.height == 120.0f);
  // The kinds and flags the conversion decided on
  int paths = 0, images = 0, texts = 0, current = 0, clipped = 0, gradients = 0;
  for (int i = 0; i < pic.shapeCount; i++) {
    const vg::Shape &sh = pic.shapes[i];
    CHECK(sh.data != nullptr);
    if (sh.kind == vg::ShapeKind::PATH) {
      paths++;
      const vg::Path &p = *(const vg::Path *)sh.data;
      CHECK(p.opCount > 0 && p.coordCount > 0 && p.ops && p.coords);
      CHECK(!p.bounds.isEmpty() || p.bounds.height == 0.0f);  // a line has none
      if (sh.fill.gradient) gradients++;
    } else if (sh.kind == vg::ShapeKind::IMAGE) {
      images++;
      const g2::Texture &t = *(const g2::Texture *)sh.data;
      CHECK_EQ(t.width, 4);
      CHECK_EQ(t.height, 3);
      CHECK(t.format == g2::PixelFormat::ARGB4444);
    } else {
      texts++;
    }
    if (sh.flags & vg::SHAPE_FILL_CURRENT_COLOR) current++;
    if (sh.clip) clipped++;
  }
  CHECK_EQ(paths, 15);
  CHECK_EQ(images, 2);
  CHECK_EQ(texts, 2);
  CHECK_EQ(current, 1);   // the circle of the nested group
  CHECK_EQ(clipped, 2);   // the clipped group
  CHECK_EQ(gradients, 2);
  CHECK_EQ(test_vg::img0.width, 4);
  CHECK(std::strcmp(test_vg::text15.text, "Hi, vg!") == 0);

  alignas(8) static uint8_t arena[8192];
  g2::OwnedSurface s = g2::createSurface(FMT, 160, 120);
  g2::Graphics2D g(s);
  g.init(arena, sizeof arena);
  g.clear(g2::Colors::WHITE);
  g.setAntialias(false);
  g.setFont(&g2::ShapoSansP_s08c07);
  g.drawPicture(pic);
  // The rounded rectangle, from the class rule
  CHECK(g.getPixel(28, 20, false) == quantized(FMT, 0xFFFFCC00u));
  CHECK(g.getPixel(8, 8, false) == g2::Colors::WHITE);  // a rounded corner
  // The ring: the middle stop (half green) over white at the center
  const g2::Color ring = g.getPixel(80, 20, false);
  CHECK(g2::colorG(ring) > g2::colorR(ring) && g2::colorG(ring) > g2::colorB(ring));
  // The egg: white at the center of the radial gradient, dark near the edge
  CHECK(lumOf(g.getPixel(120, 30, false)) > 200);
  CHECK(lumOf(g.getPixel(100, 30, false)) < 100);
  // The dashed line: on at the start, off in a gap (6 on, 3 off, offset 2)
  CHECK(g.getPixel(10, 40, false) != g2::Colors::WHITE);
  CHECK(g.getPixel(13, 40, false) == g2::Colors::WHITE);
  // The triangle, rgb() color
  CHECK(g.getPixel(120, 48, false) == quantized(FMT, 0xFFFF8000u));
  // Even-odd: the hole is left
  CHECK(g.getPixel(123, 62, false) == quantized(FMT, 0xFF008080u));
  CHECK(g.getPixel(135, 70, false) == g2::Colors::WHITE);
  // The clipped group: teal inside the clip only
  CHECK(g.getPixel(10, 66, false) == quantized(FMT, 0xFF008080u));
  CHECK(g.getPixel(4, 70, false) == g2::Colors::WHITE);
  CHECK(g.getPixel(20, 96, false) == g2::Colors::WHITE);
  // The two uses of the dot
  CHECK(g.getPixel(70, 80, false) == quantized(FMT, 0xFFFF00FFu));
  CHECK(g.getPixel(78, 80, false) == quantized(FMT, 0xFFFF00FFu));
  // The switch takes its first child
  CHECK(g.getPixel(1, 1, false) == quantized(FMT, 0xFF123456u));
  CHECK(g.getPixel(5, 1, false) == g2::Colors::WHITE);
  // The hidden rectangles are not there (above the text's line box)
  CHECK(g.getPixel(148, 101, false) == g2::Colors::WHITE);
#if SHAPOGFX2D_TRANSFORM
  // The images (6 x 6 pixels per texel): the same texel twice, the second
  // at half opacity
  const g2::Color texel = g.getPixel(62, 92, false);
  CHECK(texel != g2::Colors::WHITE);
#if SHAPOGFX2D_BLEND
  const g2::Color half = g.getPixel(90, 92, false);
  CHECK(half != texel && half != g2::Colors::WHITE);
#endif
#endif
  // The bitmap-font texts drew something dark where they are
  int dark = 0;
  for (int y = 100; y < 112; y++)
    for (int x = 120; x < 160; x++)
      if (lumOf(g.getPixel(x, y, false)) < 100) dark++;
  CHECK(dark > 10);
  // Drawing again gives the same pixels; antialiased, the same inside
  g2::OwnedSurface s2 = g2::createSurface(FMT, 160, 120);
  g2::Graphics2D g2c(s2);
  g2c.init(arena, sizeof arena);
  g2c.clear(g2::Colors::WHITE);
  g2c.setAntialias(false);
  g2c.setFont(&g2::ShapoSansP_s08c07);
  g2c.drawPicture(pic);
  CHECK(std::memcmp(s.pixels(), s2.pixels(), s.bytes()) == 0);
  g2c.clear(g2::Colors::WHITE);
  g2c.setAntialias(true);
  g2c.drawPicture(pic);
  CHECK(g2c.getPixel(28, 20, false) == quantized(FMT, 0xFFFFCC00u));
  CHECK(g2c.getPixel(120, 48, false) == quantized(FMT, 0xFFFF8000u));

  // The same SVG with a font: the texts are outlined paths
  const vg::Picture &pt = test_vg_text::picture;
  CHECK_EQ(pt.shapeCount, 19);
  int textPaths = 0;
  for (int i = 0; i < pt.shapeCount; i++) {
    CHECK(pt.shapes[i].kind != vg::ShapeKind::TEXT);
    if (pt.shapes[i].kind == vg::ShapeKind::PATH) {
      const vg::Path &p = *(const vg::Path *)pt.shapes[i].data;
      if (p.bounds.y >= 70.0f && p.bounds.x >= 118.0f && p.opCount > 40) textPaths++;
    }
  }
  CHECK_EQ(textPaths, 2);
  g.clear(g2::Colors::WHITE);
  g.drawPicture(pt);
  dark = 0;
  for (int y = 100; y < 112; y++)
    for (int x = 120; x < 160; x++)
      if (lumOf(g.getPixel(x, y, false)) < 100) dark++;
  CHECK(dark > 10);
  // "end" anchored at x = 150: nothing right of it
  for (int y = 70; y < 82; y++)
    for (int x = 151; x < 160; x++) CHECK(g.getPixel(x, y, false) == g2::Colors::WHITE);
}

#if SHAPOGFX2D_RIG && SHAPOGFX2D_TRANSFORM
// The armature svg2cpp made of test/data/test_vg_anim.svg (--keep kept,
// 30 fps, 2 s)
static void testSvg2cppRig() {
  namespace rig = shapoco::gfx2d::rig;
  const g2::PixelFormat FMT = g2::PixelFormat::RGB565_SWAPPED;
  const rig::Armature &arm = test_vg_anim::armature;
  const rig::Animation &anim = test_vg_anim::anim_main;
  CHECK_EQ(arm.boneCount, 13);
  CHECK_EQ(arm.slotCount, 8);
  CHECK_EQ(arm.features, rig::FEATURE_SLOT_COLOR | rig::FEATURE_STROKE_WIDTH);
  CHECK(arm.bounds.width == 200.0f && arm.bounds.height == 120.0f);
  CHECK_EQ(test_vg_anim::ANIMATION_COUNT, 1);
  CHECK(test_vg_anim::animations[0] == &anim);
  CHECK_EQ(anim.duration, 60);
  CHECK_EQ(anim.frameRate, 30);
  CHECK_EQ(anim.signature, arm.signature);
  for (int s = 0; s < arm.slotCount; s++) {
    const rig::Slot &sl = arm.slots[s];
    CHECK_EQ(sl.attachmentCount, 1);
    CHECK(sl.attachments[0].kind == rig::AttachmentKind::VECTOR);
    CHECK(sl.attachments[0].ext != nullptr);
  }
  alignas(4) static uint8_t mem[1024];
  rig::Instance inst;
  CHECK(inst.init(arm, mem, sizeof mem));
  const int wheel = inst.boneIndex("wheel"), kept = inst.boneIndex("kept"),
            blob = inst.boneIndex("blob");
  const int fader = inst.slotIndex("fader"), blinker = inst.slotIndex("blinker");
  CHECK_EQ(wheel, 2);
  CHECK_EQ(kept, 5);
  CHECK_EQ(blob, 7);
  CHECK_EQ(fader, 3);
  CHECK_EQ(blinker, 6);
  CHECK_EQ(inst.slotIndex("root"), 0);  // the collapsed static backdrop
  auto near = [](float a, float b) { return std::fabs(a - b) < 0.02f; };
  // Frame 0: the bind pose
  CHECK(inst.pose(anim, 0.0f));
  CHECK(inst.colorOf(fader) == g2::makeColor(204, 51, 102));
  CHECK(near(inst.boneTransform(wheel).a, 1.0f) && near(inst.boneTransform(wheel).b, 0.0f));
  CHECK(near(inst.boneTransform(wheel).tx, 40.0f) && near(inst.boneTransform(wheel).ty, 60.0f));
  CHECK_EQ(inst.attachmentOf(blinker), 0);
  // 0.5 s: the wheel a quarter turn, the slider at 60, the blob at 130, the
  // blinker hidden
  CHECK(inst.pose(anim, 15.0f));
  CHECK(near(inst.boneTransform(wheel).a, 0.0f) && near(inst.boneTransform(wheel).b, 1.0f));
  CHECK(near(inst.boneTransform(kept).tx, 140.0f) && near(inst.boneTransform(kept).ty, 10.0f));
  CHECK(near(inst.boneTransform(blob).tx, 130.0f) && near(inst.boneTransform(blob).ty, 80.0f));
  CHECK(near(inst.boneTransform(blob).a, 1.0f));
  CHECK_EQ(inst.attachmentOf(blinker), -1);
  // 1 s: the fader's color halfway, the blob's radius growing (begin 0.5 s)
  CHECK(inst.pose(anim, 30.0f));
  CHECK(nearColor(inst.colorOf(fader), g2::makeColor(127, 127, 102), 2));
  CHECK_EQ(inst.attachmentOf(blinker), 0);
  CHECK(near(inst.boneTransform(blob).a, 1.5f) && near(inst.boneTransform(blob).d, 1.5f));
  // 1.5 s: frozen at twice the radius
  CHECK(inst.pose(anim, 45.0f));
  CHECK(near(inst.boneTransform(blob).a, 2.0f));
  // The blob's stroke width: 1 -> 3 over a second, divided by the radius
  // scale (so the drawn width is what SVG shows): 1 at 0 s, 2 at 0.5 s
  // (scale 1), 2 / 2 = 1 just before 1.5 s... and 3 / 2 at 2 s
  const int blobSlot = inst.slotIndex("blob");
  CHECK_EQ(blobSlot, 4);
  CHECK(inst.pose(anim, 0.0f));
  CHECK(near(inst.strokeWidthOf(blobSlot), 1.0f));
  CHECK(inst.pose(anim, 15.0f));
  CHECK(near(inst.strokeWidthOf(blobSlot), 2.0f));
  CHECK(inst.pose(anim, 60.0f));
  CHECK(near(inst.strokeWidthOf(blobSlot), 1.5f));
  // Drawn: the backdrop, the wheel's bar vertical at frame 0 and horizontal
  // at 0.5 s
  alignas(8) static uint8_t arena[8192];
  g2::OwnedSurface s = g2::createSurface(FMT, 200, 120);
  g2::Graphics2D g(s);
  g.init(arena, sizeof arena);
  g.setAntialias(false);
  inst.pose(anim, 0.0f);
  g.clear(g2::Colors::BLACK);
  inst.draw(g);
  CHECK(g.getPixel(100, 110, false) == quantized(FMT, 0xFFEEEEEEu));
  CHECK(lumOf(g.getPixel(40, 45, false)) < 80);   // the bar
  CHECK(lumOf(g.getPixel(55, 60, false)) > 80);   // the gradient disc
  CHECK(g.getPixel(85, 13, false) == quantized(FMT, 0xFF3366CCu));  // kept
  CHECK(g.getPixel(175, 105, false) == quantized(FMT, 0xFF660066u));  // blinker
  // drawBind() draws the bind pose the same
  g2::OwnedSurface sb = g2::createSurface(FMT, 200, 120);
  g2::Graphics2D gb(sb);
  gb.init(arena, sizeof arena);
  gb.setAntialias(false);
  gb.clear(g2::Colors::BLACK);
  rig::drawBind(gb, arm);
  CHECK(std::memcmp(s.pixels(), sb.pixels(), s.bytes()) == 0);
  inst.pose(anim, 15.0f);
  g.clear(g2::Colors::BLACK);
  inst.draw(g);
  CHECK(lumOf(g.getPixel(55, 60, false)) < 80);   // the bar, turned
  CHECK(lumOf(g.getPixel(40, 45, false)) > 80);
  CHECK(g.getPixel(145, 13, false) == quantized(FMT, 0xFF3366CCu));  // kept moved
  CHECK(g.getPixel(175, 105, false) == quantized(FMT, 0xFFEEEEEEu));  // blinker hidden
  // The fader: its color at frame 0, something else (faded, halfway) at 1 s
  inst.pose(anim, 0.0f);
  g.clear(g2::Colors::BLACK);
  inst.draw(g);
  CHECK(g.getPixel(95, 36, false) == quantized(FMT, 0xFFCC3366u));
  inst.pose(anim, 30.0f);
  g.clear(g2::Colors::BLACK);
  inst.draw(g);
  const g2::Color faded = g.getPixel(95, 36, false);
  CHECK(faded != quantized(FMT, 0xFFCC3366u) && faded != quantized(FMT, 0xFFEEEEEEu));
  CHECK(g2::colorG(faded) > g2::colorR(faded) - 40);
  inst.deinit();
}
#endif

void testTools() {
  testImg2cpp();
  testDbones2cpp();
  testSvg2cppPicture();
#if SHAPOGFX2D_RIG && SHAPOGFX2D_TRANSFORM
  testSvg2cppRig();
#endif
  testGltf2cpp();
  testPackedVertices();
  testDeepTree();
}
